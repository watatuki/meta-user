## conf/layer.conf
```bitbake
# We have a conf and classes directory, add to BBPATH
BBPATH .= ":${LAYERDIR}"

# We have recipes-* directories, add to BBFILES
BBFILES += "${LAYERDIR}/recipes-*/*/*.bb"

BBFILE_COLLECTIONS += "user"
BBFILE_PATTERN_user = "^${LAYERDIR}/"
BBFILE_PRIORITY_user = "1"

# This should only be incremented on significant changes that will
# cause compatibility issues with other layers
LAYERVERSION_user = "1"

LAYERDEPENDS_user = "core"
```
